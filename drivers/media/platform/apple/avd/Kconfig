## drivers/media/platform/apple/avd/Kconfig
```kconfig
# SPDX-License-Identifier: GPL-2.0

config VIDEO_APPLE_AVD
	tristate "Apple Silicon Video Decoding driver"
	depends on VIDEO_DEV
	depends on MEDIA_CONTROLLER
	depends on ARCH_APPLE || (COMPILE_TEST && 64BIT)
	depends on OF_ADDRESS
	depends on V4L_PLATFORM_DRIVERS
	select V4L2_MEM2MEM_DEV
	select VIDEOBUF2_DMA_CONTIG
	select V4L2_H264
	help
	  Support for hardware video decoding on Apple Silicon devices using
	  the Apple Video Decoder (AVD).
          To compile this driver as a module, choose M here: the module will
          be called apple-avd.
```
